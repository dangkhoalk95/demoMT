SYStem.RESet
SYStem.CPU CORTEXM4
sys.config memoryaccessport 3

system.option enreset 	off
system.option trst off
SYStem.JtagClock 1MHz
sys.o cflush on
SYStem.Up

setup.IMASKHLL ON
setup.IMASKASM ON

Break.Select Program OnChip
Break.Select Hll OnChip
Break.Select Spot OnChip
Break.Select Read OnChip
Break.Select Write OnChip

;config JTAG
D.S SD:0xA20E0094        %LE %LONG 0x76867682
D.S SD:0xA20E0098        %LE %LONG 0x76867682
D.S SD:0xA20E009C        %LE %LONG 0x76867682

;PND all on
D.S SD:0xA2030b20        %LE %LONG 0xfffffff
D.S SD:0xA21D0320        %LE %LONG 0xfffffff

;disable watch dog
D.S SD:0xA2090000        %LE %LONG 0x2200

;EMI init
D.S SD:0x0        %LE %LONG 0x5a5a5a5a
D.S SD:0x4        %LE %LONG 0x5a5a5a5a
D.S SD:0xA00500A0 %LE %LONG 0x0d030000
D.S SD:0xA0050030 %LE %LONG 0x0
D.S SD:0xA0050048 %LE %LONG 0x1e0000 

;disable boot slave
D.S SD:0xA21E0008 %LE %LONG 0x0

;disable cache 
D.S SD:0xE0180000 %LE %LONG 0x0

Local &start &end
&start=clock.seconds()

&end=clock.seconds()
Print "Elapsed time is " &end-&start    " seconds"

; ===================================================================
; Download the binary image to PSRAM directly
; ===================================================================
D.LOAD.ELF ..\..\..\..\..\out\mt7682_hdk\audio_ref_design\audio_ref_design.elf  /quad

R.S R13 0x04018000		; set stack pointer to the end of CM4 TCM
R.S PC Reset_Handler	; real target bypass BROM effect

y.spath project/mt7682_hdk/apps/audio_ref_design/

winclear


D.L

v.watch %Hex (SCB_Type *)0xE000ED00
v.watch %Hex (NVIC_Type *)0xE000E100
v.watch %Hex (MPU_Type *)0xE000ED90

